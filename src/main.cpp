#include <Arduino.h>
#include <Adafruit_GFX.h>
#include <Adafruit_ST7735.h>
#include <Wire.h>
#include <BH1750.h>
#include <math.h>
#include <Gamer8ptb.h>

#define TFT_CS 10
#define TFT_RST 9
#define TFT_DC 8

Adafruit_ST7735 tft = Adafruit_ST7735(TFT_CS, TFT_DC, TFT_RST);
BH1750 lightMeter;

void setScreenBrightness();
void displayTurboAnimation();
void displayProgress();

// 64x24px
const unsigned char turbo_bitmap[] PROGMEM = {
    0x00, 0x00, 0x03, 0xc0, 0x00, 0x00, 0x00, 0x00, 0x00, 0x7f, 0xfc, 0x20, 0x00, 0x00, 0x00, 0x00,
    0x01, 0x80, 0x00, 0x20, 0x00, 0x00, 0x00, 0x00, 0x06, 0x00, 0x00, 0x20, 0x00, 0x00, 0x00, 0x00,
    0x08, 0x00, 0x00, 0x20, 0x7e, 0xdb, 0xef, 0xbe, 0x10, 0x00, 0x00, 0x20, 0x18, 0xdb, 0x6d, 0xb6,
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    0x01, 0x80, 0xc0, 0x00, 0x00, 0x00, 0x00, 0x00, 0x00, 0x7f, 0x00, 0x00, 0x00, 0x00, 0x00, 0x00};

// 128x25px
const unsigned char slider_bitmap[] PROGMEM = {
    0xf8, 0x00, 0x00, 0x01, 0xf0, 0x00, 0x00, 0x0e, 0x7c, 0x00, 0x00, 0x1c, 0xf8, 0x00, 0x00, 0x00,
    0xd8, 0x00, 0x00, 0x01, 0x80, 0x00, 0x00, 0x06, 0x6c, 0x00, 0x00, 0x0c, 0xc0, 0x00, 0x00, 0x00,
    0xd8, 0x00, 0x00, 0x01, 0xf0, 0x00, 0x00, 0x06, 0x6c, 0x00, 0x00, 0x0c, 0xf8, 0x00, 0x00, 0x00,
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    0x7f, 0xff, 0xff, 0xff, 0xff, 0xff, 0xff, 0xff, 0xff, 0xff, 0xff, 0xff, 0xff, 0xff, 0xff, 0xfe};

void setup()
{
  pinMode(3, OUTPUT);
  Wire.begin();
  lightMeter.begin();

  tft.initR(INITR_BLACKTAB);
  tft.fillScreen(ST7735_BLACK);
  tft.setRotation(3);
  tft.setFont(&Gamer8pt7b);

  tft.drawBitmap(0, 0, turbo_bitmap, 64, 24, ST7735_WHITE);
  tft.drawBitmap(5, 30, slider_bitmap, 128, 25, ST7735_WHITE);
}

int x = 0;
float lux = 0;
bool hasToResetText = false;

void loop()
{

  lux = lightMeter.readLightLevel();
  setScreenBrightness();

  displayTurboAnimation();
  displayProgress();
}

void setScreenBrightness()
{
  int luxInt = static_cast<int>(lux);
  int cappedLux = min(luxInt, 57);

  int brightness = 27 + (cappedLux * 4);
  analogWrite(3, brightness);
}

// 16x9px
const unsigned char turbo_bitmap_anim_frame_1[] PROGMEM = {
    0x01, 0x00, 0x09, 0x20, 0x05, 0x40, 0x03, 0x80, 0x1f, 0xf0, 0x03, 0x80, 0x05, 0x40, 0x09, 0x20,
    0x01, 0x00};

const unsigned char turbo_bitmap_anim_frame_2[] PROGMEM = {
    0x00, 0x80, 0x04, 0x80, 0x02, 0xa0, 0x1f, 0xc0, 0x03, 0x80, 0x07, 0xf0, 0x0a, 0x80, 0x02, 0x40,
    0x02, 0x00};

const unsigned char turbo_bitmap_anim_frame_3[] PROGMEM = {
    0x02, 0x00, 0x02, 0x40, 0x0a, 0x80, 0x07, 0xf0, 0x03, 0x80, 0x1f, 0xc0, 0x02, 0xa0, 0x04, 0x80,
    0x00, 0x80};

const int turbo_bitmap_frame_lenght = 3;
const unsigned char *turbo_bitmap_frame_allArray[3] = {
    turbo_bitmap_anim_frame_1,
    turbo_bitmap_anim_frame_2,
    turbo_bitmap_anim_frame_3};

GFXcanvas1 animationBuffer(16, 9);
int currentFrame = 0;
int prevFrame = 0;
unsigned long previousMillis = 0;
const long interval = 50;

void displayTurboAnimation()
{
  unsigned long currentMillis = millis();
  if (currentMillis - previousMillis < interval)
    return;

  previousMillis = currentMillis;

  animationBuffer.fillRect(0, 0, 16, 9, ST7735_BLACK);
  animationBuffer.drawBitmap(-5, -8, turbo_bitmap, 64, 24, ST7735_WHITE);
  animationBuffer.drawBitmap(0, 0, turbo_bitmap_frame_allArray[currentFrame], 16, 9, ST7735_WHITE);

  tft.drawBitmap(5, 8, animationBuffer.getBuffer(), 16, 9, ST7735_WHITE, ST7735_BLACK);

  prevFrame = currentFrame;
  currentFrame++;
  if (currentFrame >= turbo_bitmap_frame_lenght)
  {
    currentFrame = 0;
  }
}

int prevProgress = 0;
int progress = 0;
int maxProgress = 90;
int progressStep = 4;
unsigned long previousMillis1 = 0;
const long interval1 = 16;

void displayProgress()
{
  unsigned long currentMillis = millis();
  if (currentMillis - previousMillis1 < interval1)
    return;

  previousMillis1 = currentMillis;

  if (prevProgress > progress)
  {
    tft.fillRect(7 + progress, 43, max(0, prevProgress - progress), 10, ST7735_BLACK);
  }
  else
  {
    tft.fillRect(7, 43, progress, 10, ST7735_WHITE);
  }

  prevProgress = progress;
  progress = max(progress + progressStep, 0);
  if (progress > maxProgress)
  {
    progressStep = -4;
  }
  else if (progress <= 0)
  {
    progressStep = 4;
  }
}